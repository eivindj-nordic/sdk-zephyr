## prj.conf
```kconfig
CONFIG_ZTEST=y
CONFIG_STDOUT_CONSOLE=y
CONFIG_FLASH=y
CONFIG_FLASH_PAGE_LAYOUT=y
CONFIG_FLASH_MAP=y
CONFIG_ARM_MPU=n
CONFIG_FCB=y
CONFIG_FCB_CRC_DISABLED_ALLOW=y
CONFIG_SOC_FLASH_NRF_EMULATE_ONE_BYTE_WRITE_ACCESS=y
CONFIG_ZTEST_NEW_API=y
```

## prj_native_posix_64.conf
```kconfig
CONFIG_ZTEST=y
CONFIG_STDOUT_CONSOLE=y
CONFIG_FLASH=y
CONFIG_FLASH_PAGE_LAYOUT=y
CONFIG_FLASH_MAP=y
CONFIG_FCB=y
CONFIG_FCB_CRC_DISABLED_ALLOW=y
CONFIG_ZTEST_NEW_API=y
```

## prj_nucleo_h743zi.conf
```kconfig
# General Zephyr configurations
CONFIG_ZTEST=y
CONFIG_STDOUT_CONSOLE=y
CONFIG_FLASH=y
CONFIG_FLASH_PAGE_LAYOUT=y
CONFIG_FLASH_MAP=y
CONFIG_ARM_MPU=n
CONFIG_FCB=y
CONFIG_FCB_CRC_DISABLED_ALLOW=y
CONFIG_MAIN_STACK_SIZE=4096
CONFIG_SYSTEM_WORKQUEUE_STACK_SIZE=4096
CONFIG_ZTEST_NEW_API=y
```

## prj_qemu_x86.conf
```kconfig
CONFIG_ZTEST=y
CONFIG_STDOUT_CONSOLE=y
CONFIG_FLASH=y
CONFIG_FLASH_PAGE_LAYOUT=y
CONFIG_FLASH_MAP=y
CONFIG_FCB=y
CONFIG_FCB_CRC_DISABLED_ALLOW=y
CONFIG_FLASH_SIMULATOR_UNALIGNED_READ=y
CONFIG_ZTEST_NEW_API=y
```

## src/main.c
```c
/*
 * Copyright (c) 2017-2020 Nordic Semiconductor ASA
 * Copyright (c) 2015 Runtime Inc
 *
 * SPDX-License-Identifier: Apache-2.0
 */

#include <stdio.h>
#include <string.h>

#include "fcb_test.h"
#include <zephyr/storage/flash_map.h>
#include <zephyr/drivers/flash.h>
#include <zephyr/device.h>

struct fcb test_fcb = {0};
struct fcb test_fcb_crc_disabled = { .f_crc_disable = 1 };

uint8_t fcb_test_erase_value;

#if defined(CONFIG_SOC_SERIES_STM32H7X)
	#define SECTOR_SIZE 0x20000 /* 128K */
#else
	#define SECTOR_SIZE 0x4000 /* 16K */
#endif

/* Sectors for FCB are defined far from application code
 * area. This test suite is the non bootable application so 1. image slot is
 * suitable for it.
 */
struct flash_sector test_fcb_sector[] = {
	[0] = {
		.fs_off = 0,
		.fs_size = SECTOR_SIZE
	},
	[1] = {
		.fs_off = SECTOR_SIZE,
		.fs_size = SECTOR_SIZE
	},
	[2] = {
		.fs_off = 2 * SECTOR_SIZE,
		.fs_size = SECTOR_SIZE
	},
	[3] = {
		.fs_off = 3 * SECTOR_SIZE,
		.fs_size = SECTOR_SIZE
	}
};


void test_fcb_wipe(void)
{
	int i;
	int rc;
	const struct flash_area *fap;

	rc = flash_area_open(TEST_FCB_FLASH_AREA_ID, &fap);
	zassert_true(rc == 0, "flash area open call failure");

	for (i = 0; i < ARRAY_SIZE(test_fcb_sector); i++) {
		rc = flash_area_erase(fap, test_fcb_sector[i].fs_off,
				      test_fcb_sector[i].fs_size);
		zassert_true(rc == 0, "erase call failure");
	}
}

int fcb_test_empty_walk_cb(struct fcb_entry_ctx *entry_ctx, void *arg)
{
	zassert_unreachable("fcb_test_empty_walk_cb");
	return 0;
}

uint8_t fcb_test_append_data(int msg_len, int off)
{
	return (msg_len ^ off);
}

int fcb_test_data_walk_cb(struct fcb_entry_ctx *entry_ctx, void *arg)
{
	uint16_t len;
	uint8_t test_data[128];
	int rc;
	int i;
	int *var_cnt = (int *)arg;

	len = entry_ctx->loc.fe_data_len;

	zassert_true(len == *var_cnt, "");

	rc = flash_area_read(entry_ctx->fap,
			     FCB_ENTRY_FA_DATA_OFF(entry_ctx->loc),
			     test_data, len);
	zassert_true(rc == 0, "read call failure");

	for (i = 0; i < len; i++) {
		zassert_true(test_data[i] == fcb_test_append_data(len, i),
		"fcb_test_append_data redout misrepresentation");
	}
	(*var_cnt)++;
	return 0;
}

int fcb_test_cnt_elems_cb(struct fcb_entry_ctx *entry_ctx, void *arg)
{
	struct append_arg *aa = (struct append_arg *)arg;
	int idx;

	idx = entry_ctx->loc.fe_sector - &test_fcb_sector[0];
	aa->elem_cnts[idx]++;
	return 0;
}

void fcb_tc_pretest(int sectors, struct fcb *fcb)
{
	int rc = 0;

	test_fcb_wipe();
	fcb->f_erase_value = fcb_test_erase_value;
	fcb->f_sector_cnt = sectors;
	fcb->f_sectors = test_fcb_sector; /* XXX */

	rc = 0;
	rc = fcb_init(TEST_FCB_FLASH_AREA_ID, fcb);
	if (rc != 0) {
		printf("%s rc == %xm, %d\n", __func__, rc, rc);
		zassert_true(rc == 0, "fbc initialization failure");
	}
}

static void fcb_pretest_2_sectors(void *data)
{
	fcb_tc_pretest(2, &test_fcb);
}

static void fcb_pretest_4_sectors(void *data)
{
	fcb_tc_pretest(4, &test_fcb);
}

static void fcb_pretest_crc_disabled(void *data)
{
	fcb_tc_pretest(2, &test_fcb_crc_disabled);
}

/*
 * This actually is not a test; the function gets erase value from flash
 * parameters, of the flash device that is used by tests, and stores it in
 * global fcb_test_erase_value.
 */
ZTEST(fcb_test_without_set, test_get_flash_erase_value)
{
	const struct flash_area *fa;
	const struct flash_parameters *fp;
	const struct device *dev;
	int rc = 0;

	rc = flash_area_open(TEST_FCB_FLASH_AREA_ID, &fa);
	zassert_equal(rc, 0, "Failed top open flash area");

	dev = fa->fa_dev;
	flash_area_close(fa);

	zassert_true(dev != NULL, "Failed to obtain device");

	fp = flash_get_parameters(dev);
	zassert_true(fp != NULL, "Failed to get flash device parameters");

	fcb_test_erase_value = fp->erase_value;
}

ZTEST_SUITE(fcb_test_without_set, NULL, NULL, NULL, NULL, NULL);
ZTEST_SUITE(fcb_test_with_2sectors_set, NULL, NULL, fcb_pretest_2_sectors, NULL, NULL);
ZTEST_SUITE(fcb_test_with_4sectors_set, NULL, NULL, fcb_pretest_4_sectors, NULL, NULL);

ZTEST_SUITE(fcb_test_crc_disabled, NULL, NULL, fcb_pretest_crc_disabled, NULL, NULL);
```

## src/fcb_test.h
```c
/*
 * Copyright (c) 2017-2020 Nordic Semiconductor ASA
 * Copyright (c) 2015 Runtime Inc
 *
 * SPDX-License-Identifier: Apache-2.0
 */

#ifndef _FCB_TEST_H
#define _FCB_TEST_H

#include <stdio.h>
#include <string.h>
#include <zephyr/ztest.h>

#include <zephyr/fs/fcb.h>
#include "fcb_priv.h"
#include <errno.h>

#ifdef __cplusplus
extern "C" {
#endif

#define TEST_FCB_FLASH_AREA		slot1_partition
#define TEST_FCB_FLASH_AREA_ID		FIXED_PARTITION_ID(TEST_FCB_FLASH_AREA)

extern struct fcb test_fcb;
extern struct fcb test_fcb_crc_disabled;

extern struct flash_sector test_fcb_sector[];

extern uint8_t fcb_test_erase_value;

struct append_arg {
	int *elem_cnts;
};

void test_fcb_wipe(void);
int fcb_test_empty_walk_cb(struct fcb_entry_ctx *entry_ctx, void *arg);
uint8_t fcb_test_append_data(int msg_len, int off);
int fcb_test_data_walk_cb(struct fcb_entry_ctx *entry_ctx, void *arg);
int fcb_test_cnt_elems_cb(struct fcb_entry_ctx *entry_ctx, void *arg);

#ifdef __cplusplus
}
#endif
#endif /* _FCB_TEST_H */
```

## src/fcb_test_append.c
```c
/*
 * Copyright (c) 2017 Nordic Semiconductor ASA
 * Copyright (c) 2015 Runtime Inc
 *
 * SPDX-License-Identifier: Apache-2.0
 */

#include "fcb_test.h"

void test_fcb_append(struct fcb *fcb)
{
	int rc;
	struct fcb_entry loc;
	uint8_t test_data[128];
	int i;
	int j;
	int var_cnt;

	for (i = 0; i < sizeof(test_data); i++) {
		for (j = 0; j < i; j++) {
			test_data[j] = fcb_test_append_data(i, j);
		}
		rc = fcb_append(fcb, i, &loc);
		zassert_true(rc == 0, "fcb_append call failure");
		rc = flash_area_write(fcb->fap, FCB_ENTRY_FA_DATA_OFF(loc),
				      test_data, i);
		zassert_true(rc == 0, "flash_area_write call failure");
		rc = fcb_append_finish(fcb, &loc);
		zassert_true(rc == 0, "fcb_append_finish call failure");
	}

	var_cnt = 0;
	rc = fcb_walk(fcb, 0, fcb_test_data_walk_cb, &var_cnt);
	zassert_true(rc == 0, "fcb_walk call failure");
	zassert_true(var_cnt == sizeof(test_data),
		     "fetched data size not match to wrote data size");
}

ZTEST(fcb_test_with_2sectors_set, test_fcb_append)
{
	test_fcb_append(&test_fcb);
}

ZTEST(fcb_test_crc_disabled, test_fcb_append)
{
	test_fcb_append(&test_fcb_crc_disabled);
}
```

## src/fcb_test_append_too_big.c
```c
/*
 * Copyright (c) 2017 Nordic Semiconductor ASA
 * Copyright (c) 2015 Runtime Inc
 *
 * SPDX-License-Identifier: Apache-2.0
 */

#include "fcb_test.h"

ZTEST(fcb_test_with_2sectors_set, test_fcb_append_too_big)
{
		struct fcb *fcb;
		int rc;
		int overhead;
		uint32_t len;
		struct fcb_entry elem_loc;
		const uint8_t max_length_field_len = 2;

		fcb = &test_fcb;

		/*
		 * An entry in the FCB has the following structure:
		 * | fcb_disk_area | length | data | CRC |
		 *
		 * The length is encoded in 1-2 bytes. All these entries
		 * have to abide flash alignment constraints.
		 *
		 * Thus, the max element which fits inside sector is
		 * (M / fcb->f_align) * fcb->f_align, where / is integer
		 * division and M = sector size - O, with O being the sum
		 * of all overhead elements' lengths in flash, i.e.
		 *
		 * O = fcb_len_in_flash(fcb, FCB_CRC_SZ)
		 *    + fcb_len_in_flash(fcb, max_length_field_len)
		 *    + fcb_len_in_flash(fcb, sizeof(struct fcb_disk_area))
		 */
		len = MIN(FCB_MAX_LEN
			     + fcb_len_in_flash(fcb, sizeof(struct fcb_disk_area))
			     + fcb_len_in_flash(fcb, FCB_CRC_SZ)
			     + fcb_len_in_flash(fcb, max_length_field_len)
			, fcb->f_active.fe_sector->fs_size);


		rc = fcb_append(fcb, len, &elem_loc);
		zassert_true(rc != 0,
			     "fcb_append call should fail for too big entry");

		len--;
		rc = fcb_append(fcb, len, &elem_loc);
		zassert_true(rc != 0,
			     "fcb_append call should fail for too big entry");

		len -=  fcb_len_in_flash(fcb, sizeof(struct fcb_disk_area));
		rc = fcb_append(fcb, len, &elem_loc);
		zassert_true(rc != 0,
			     "fcb_append call should fail for too big entry");

		overhead = fcb_len_in_flash(fcb, sizeof(struct fcb_disk_area))
			   + fcb_len_in_flash(fcb, max_length_field_len)
			   + fcb_len_in_flash(fcb, FCB_CRC_SZ);

		len = MIN(FCB_MAX_LEN, fcb->f_active.fe_sector->fs_size - overhead);
		len = fcb->f_align * (len / fcb->f_align);

		rc = fcb_append(fcb, len, &elem_loc);
		zassert_true(rc == 0, "fcb_append call failure");

		rc = fcb_append_finish(fcb, &elem_loc);
		zassert_true(rc == 0, "fcb_append call failure");

		rc = fcb_elem_crc8_validate(fcb, &elem_loc, 1);
		zassert_true(rc == 0, "fcb_elem_crc8_validate call failure");
		zassert_true(elem_loc.fe_data_len == len,
		"entry length fetched should match length of appended entry");
}
```
